/ {
	amba_pl: amba_pl {
		ranges;
		compatible = "simple-bus";
		#address-cells = <1>;
		#size-cells = <1>;
		metronome_ip_0: metronome_ip@43c00000 {
			xlnx,s00-axi-data-width = <32>;
			xlnx,rable = <0>;
			compatible = "xlnx,metronome-ip-1.0";
			status = "okay";
			clock-names = "s00_axi_aclk";
			xlnx,s00-axi-addr-width = <4>;
			xlnx,ip-name = "metronome_ip";
			xlnx,edk-iptype = "PERIPHERAL";
			reg = <0x43c00000 0x10000>;
			clocks = <&clkc 15>;
			xlnx,name = "metronome_ip_0";
		};
	};
};
